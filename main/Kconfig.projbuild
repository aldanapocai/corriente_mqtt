## main/Kconfig.projbuild
```kconfig
menu "Example Configuration"

    config BROKER_URI
        string "Broker URL"
        default "mqtts://mqtt.eclipseprojects.io:8883"
        help
            URL of an mqtt broker which this example connects to.

    config MQTT_USERNAME
        string "MQTT Username"
        default ""     # o "your_user_here"
        help
        Fill in your MQTT username via menuconfig.

    config MQTT_PASSWORD
        string "MQTT Password"
        default ""     # o "your_pass_here"
        help
        Fill in your MQTT password via menuconfig.


    config BROKER_CERTIFICATE_OVERRIDDEN
        bool
        default y if BROKER_CERTIFICATE_OVERRIDE != ""

    config BROKER_BIN_SIZE_TO_SEND
        # This option is not visible and is used only to set parameters for example tests
        # Here we configure the data size to send and to be expected in the python script
        int
        default 20000

endmenu
```
